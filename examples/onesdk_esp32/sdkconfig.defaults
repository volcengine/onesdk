## examples/onesdk_esp32/sdkconfig.defaults
```kconfig
# Override some defaults
CONFIG_FREERTOS_HZ=1000
CONFIG_FATFS_CODEPAGE_936=y
CONFIG_FATFS_LFN_HEAP=y
CONFIG_FATFS_MAX_LFN=255
CONFIG_FATFS_FS_LOCK=5
CONFIG_FREERTOS_ENABLE_BACKWARD_COMPATIBILITY=y

CONFIG_ESP_MAIN_TASK_STACK_SIZE=50000
CONFIG_PARTITION_TABLE_CUSTOM=y
CONFIG_PARTITION_TABLE_CUSTOM_FILENAME="partitions_example.csv"
CONFIG_PARTITION_TABLE_FILENAME="partitions_example.csv"
# CONFIG_ESPTOOLPY_FLASHSIZE_2MB=y
CONFIG_ESPTOOLPY_FLASHSIZE_4MB=y
# CONFIG_ESPTOOLPY_FLASHSIZE_8MB is not set
# CONFIG_ESPTOOLPY_FLASHSIZE_16MB is not set
# CONFIG_ESPTOOLPY_FLASHSIZE_32MB is not set
# CONFIG_ESPTOOLPY_FLASHSIZE_64MB is not set
# CONFIG_ESPTOOLPY_FLASHSIZE_128MB is not set
CONFIG_ESPTOOLPY_FLASHSIZE="4MB"
```

## examples/onesdk_esp32/sdkconfig.defaults.esp32s3
```kconfig
CONFIG_IDF_CMAKE=y
CONFIG_IDF_TARGET_ARCH_XTENSA=y
CONFIG_IDF_TARGET="esp32s3"
CONFIG_IDF_TARGET_ESP32S3=y
CONFIG_IDF_FIRMWARE_CHIP_ID=0x0009
# CONFIG_ESP_MAIN_TASK_STACK_SIZE=50000
CONFIG_PARTITION_TABLE_CUSTOM=y
CONFIG_PARTITION_TABLE_CUSTOM_FILENAME="partitions_example.csv"
CONFIG_PARTITION_TABLE_FILENAME="partitions_example.csv"
# CONFIG_ESPTOOLPY_FLASHSIZE_2MB=y
CONFIG_ESPTOOLPY_FLASHSIZE_4MB=y
# CONFIG_ESPTOOLPY_FLASHSIZE_8MB is not set
# CONFIG_ESPTOOLPY_FLASHSIZE_16MB is not set
# CONFIG_ESPTOOLPY_FLASHSIZE_32MB is not set
# CONFIG_ESPTOOLPY_FLASHSIZE_64MB is not set
# CONFIG_ESPTOOLPY_FLASHSIZE_128MB is not set
CONFIG_ESPTOOLPY_FLASHSIZE="4MB"
# Audio HAL
#
CONFIG_ESP32_S3_KORVO2_V3_BOARD=y
```

## examples/onesdk_esp32_audio/main/Kconfig.projbuild
```kconfig
menu "Example Configuration"

choice AUDIO_DECODER_SUPPORT
    prompt "Audio Decoder"
    default AUDIO_SUPPORT_RAW_DECODER

config AUDIO_SUPPORT_G711A_DECODER
    bool "AUDIO-G711-DECODER"

config AUDIO_SUPPORT_OPUS_DECODER
    bool "AUDIO-OPUS-DECODER"

config AUDIO_SUPPORT_AAC_DECODER
    bool "AUDIO-AAC-DECODER"
config AUDIO_SUPPORT_RAW_DECODER
    bool "AUDIO-RAW-DECODER"
    prompt "AUDIO-RAW-DECODER(API GW send/recv raw data)"
endchoice

choice AUDIO_CONVERSATION_MODE_SUPPORT
    prompt "Conversion Mode"
    default LANGUAGE_WAKEUP_MODE

config LANGUAGE_WAKEUP_MODE
    bool "LANGUAGE-WAKEUP-MODE"

config CONTINUOUS_CONVERSATION_MODE
    bool "CONTINUOUS-CONVERSATION-MODE"

endchoice

endmenu
```
